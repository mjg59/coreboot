## src/drivers/applesmc/Kconfig
```kconfig
config DRIVERS_EMULATED_APPLE_SMC
	bool "Emulate Apple SMC"

config DRIVERS_APPLE_SMC_OSK
	string "Apple SMC OSK"
	default "default invalid OSK"
```

## src/ec/51nb/Kconfig
```kconfig
##
## This file is part of the coreboot project.
##
## Copyright (C) 2017 Iru Cai
##
## This program is free software; you can redistribute it and/or modify
## it under the terms of the GNU General Public License as published by
## the Free Software Foundation; version 2 of the License.
##
## This program is distributed in the hope that it will be useful,
## but WITHOUT ANY WARRANTY; without even the implied warranty of
## MERCHANTABILITY or FITNESS FOR A PARTICULAR PURPOSE.  See the
## GNU General Public License for more details.
##

config EC_51NB
	bool
	help
	  Support for the 51NB EC

if EC_51NB

comment "Please select the following otherwise your laptop cannot be powered on."

config 51NB_EC_FIRMWARE
	bool "Add firmware images for 51NB EC"
	depends on EC_51NB
	default y
	help
	  Select this option to add the firmware blob for the 51NB EC.
	  You need this blob to power on your machine.

config 51NB_EC_FW
	string "51NB EC firmware path"
	depends on 51NB_EC_FIRMWARE
	default "ec.bin"
	help
	  The path and filename of the file to use as 51NB firmware.

config 51NB_EC_FW_OFFSET
	string
	depends on 51NB_EC_FIRMWARE
	default "0x00200000"

endif
```

## src/ec/51nb/npce985la0dx/Kconfig
```kconfig
##
## This file is part of the coreboot project.
##
## Copyright (C) 2019 Google LLC
##
## This program is free software; you can redistribute it and/or modify
## it under the terms of the GNU General Public License as published by
## the Free Software Foundation; version 2 of the License.
##
## This program is distributed in the hope that it will be useful,
## but WITHOUT ANY WARRANTY; without even the implied warranty of
## MERCHANTABILITY or FITNESS FOR A PARTICULAR PURPOSE.  See the
## GNU General Public License for more details.
##

config EC_51NB_NPCE985LA0DX
	bool
	default n
	help
	  Support for the 51NB NPCE985LA0DX EC

if EC_51NB_NPCE985LA0DX

comment "Please select the following otherwise your laptop cannot be powered on."

config EC_51NB_NPCE985LA0DX_FIRMWARE
	bool "Add firmware image for 51NB NPCE985LA0DX EC"
	depends on EC_51NB_NPCE985LA0DX
	default y
	help
	  Select this option to add the firmware blob for the 51NB EC.
	  You need this blob to power on your machine.

config EC_51NB_NPCE985LA0DX_FW
	string "51NB EC firmware path"
	depends on EC_51NB_NPCE985LA0DX_FIRMWARE
	default "ec.bin"
	help
	  The path and filename of the file to use as 51NB firmware.
endif
```

## src/mainboard/51nb/x210/Kconfig
```kconfig
if BOARD_51NB_X210 || BOARD_51NB_X2100

config BOARD_SPECIFIC_OPTIONS
	def_bool y
	select BOARD_ROMSIZE_KB_8192 if BOARD_51NB_X210
	select BOARD_ROMSIZE_KB_16384 if BOARD_51NB_X2100
	select EC_51NB_NPCE985LA0DX
	select HAVE_ACPI_RESUME
	select HAVE_ACPI_TABLES
	select MAINBOARD_HAS_LIBGFXINIT
	select SOC_INTEL_COMMON_BLOCK_HDA_VERB
	select SOC_INTEL_KABYLAKE if BOARD_51NB_X210
	select SOC_INTEL_COMETLAKE_1 if BOARD_51NB_X2100
	select SPD_READ_BY_WORD
	select SYSTEM_TYPE_LAPTOP

config VARIANT_DIR
        string
	default "variants/x210" if BOARD_51NB_X210
	default "variants/x2100" if BOARD_51NB_X2100

config MAINBOARD_FAMILY
	string
	default "X210" if BOARD_51NB_X210
	default "X2100" if BOARD_51NB_X2100

config MAINBOARD_PART_NUMBER
	string
	default "X210" if BOARD_51NB_X210
	default "X2100" if BOARD_51NB_X2100

config MAINBOARD_VERSION
	string
	default "1.0"

config MAINBOARD_DIR
	string
	default "51nb/x210"

config MAX_CPUS
	int
	default 8

config VGA_BIOS_ID
	string
	default "8086,5917" if BOARD_51NB_X210
	default "8086,9b41" if BOARD_51NB_X2100

config DIMM_MAX
	int
	default 2

config DIMM_SPD_SIZE
	int
	default 512

config DEVICETREE
        string
	default "$(CONFIG_VARIANT_DIR)/devicetree.cb"

config FMDFILE
	string
	default "src/mainboard/\$(CONFIG_MAINBOARD_DIR)/\$(CONFIG_VARIANT_DIR)/board.fmd"

config NO_POST
	default y

endif
```

## src/mainboard/51nb/x210/Kconfig.name
```kconfig
config BOARD_51NB_X210
	bool "51NB X210"

config BOARD_51NB_X2100
        bool "51NB X2100"
```
